// SPDX-License-Identifier: BSD-3-Clause
/*
 * Copyright (c) 2021, Konrad Dybcio <konrad.dybcio@somainline.org>
 */

/dts-v1/;

#include "sdm845.dtsi"
#include "pm8998.dtsi"
#include "pmi8998.dtsi"

/ {
	model = "Sony Xperia XZ2 Compact";
	compatible = "sony,apollo-row", "qcom,sdm845";

	qcom,msm-id = <321 0x20001>;
	qcom,board-id = <8 0>;
};
